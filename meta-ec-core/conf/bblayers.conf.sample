## meta-ec-core/conf/distro/include/defaultsetup.inc
```bitbake
# Space-separated list of packages to install on the given distribution.
# Use =/+=/=+ to overwrite the list, :append/:prepend to modify it.
# Default: all the packages I regularly use on all environments.
PKG_INSTALL ?= " \
    neovim vscode \
    ssh \
    commit-editor diff-so-fancy git repo-aliases \
    aliases bash requests-ca-bundle oh-my-zsh proxy \
    bat eza fd nvimpager ripgrep \
    cmake gcc gdb gdb-dashboard make ninja clang-format clang-tidy clang \
"
```

## meta-ec-core/conf/distro/include/ubuntu.inc
```bitbake
# Use Apt as main package provider on Ubuntu
DISTRO_PKG_PROVIDERS:prepend = " apt "

# /!\ Use `^` and `$` to delimit the regexes, otherwise
# `clang-[0-9.]+` could match `clang-15-examples`
PKG_PROVIDER_apt_PACKAGE_PATTERN_clang = "^clang-[0-9.]+$"
PKG_PROVIDER_apt_PACKAGE_PATTERN_clang-format = "^clang-format-[0-9.]+$"
PKG_PROVIDER_apt_PACKAGE_PATTERN_clang-tidy = "^clang-tidy-[0-9.]+$"
PKG_PROVIDER_apt_PACKAGE_PATTERN_ninja = "^ninja-build$"
PKG_PROVIDER_apt_PACKAGE_PATTERN_fd = "^fd-find$"

ALIAS[bat] = "batcat"
ALIAS[fd] = "fdfind"
ALIAS[ls] = "eza"
ALIAS[ll] = "eza -lg"
ALIAS[la] = "eza -lag"
```

## meta-ec-core/conf/distro/ubuntu2404.conf
```bitbake
require conf/distro/include/ubuntu.inc

PKG_PROVIDER_apt_PACKAGE_PATTERN_libfuse2 = "^libfuse2t64$"
```

## meta-ec-core/conf/layer.conf
```bitbake
BBPATH .= ":${LAYERDIR}"
BBFILES += "${LAYERDIR}/recipes-*/*/*.bb \
            ${LAYERDIR}/recipes-*/*/*.bbappend"

BBFILE_COLLECTIONS += "ec-core"
BBFILE_PATTERN_ec-core := "^${LAYERDIR_RE}/"

# Current ec-core major version
# Incremented on significant changes causing compatibility issues with dependent meta layers
EC_CORE_VERSION = "3"

# Core meta layer codename used in meta layers that are based on env-config
EC_CORE_CORENAME = "ec-core-${EC_CORE_VERSION}"

# Since meta-ec-core is the core meta layer of env-config, the following variables must be set
LAYERSERIES_CORENAMES = "${EC_CORE_CORENAME}"
LAYERSERIES_COMPAT_ec-core = "${EC_CORE_CORENAME}"
```
